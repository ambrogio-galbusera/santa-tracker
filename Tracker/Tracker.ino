#include <Wire.h>
#include <Adafruit_GFX.h>
#include <Adafruit_SSD1306.h>
#include <WiFiNINA.h>
#include <ArduinoJson.h>
#include <FastLED.h>

#define SENSOR_PIN  3
#define LEDS_PIN    6
#define NUM_LEDS    31
#define NUM_VIS_LEDS 25
#define NUM_EXTRA   1
//#define TOTAL_LEDS  ((NUM_LEDS*2) + NUM_EXTRA)
#define TOTAL_LEDS  NUM_VIS_LEDS

#define NUM_COLS    40

#define MYSSID    "XXXXXXXX"
#define PASSWORD  "12345678"
#define HOST      "santa-api.appspot.com"
#define URL       "/info?client=web&language=en&fingerprint=&routeOffset=0&streamOffset=0"

#define SCREEN_WIDTH 128 // OLED display width, in pixels
#define SCREEN_HEIGHT 32 // OLED display height, in pixels
#define OLED_RESET    -1 // Reset pin # (or -1 if sharing Arduino reset pin)

#define APP_STARTUP   0
#define APP_FETCHING  1
#define APP_MAP       2
#define APP_SNOWFLAKE 3

#define MAP_TIME_MS       25000
#define SNOWFLAKE_TIME_MS 25000
#define FETCH_TIME_MS     50000

const unsigned char TESTIMAGE[NUM_COLS * NUM_LEDS * 4] = {
  0xff, 0x00, 0x00, 0xff, 0x00, 0x00, 0x00, 0xff, 0x00, 0x00, 0x00, 0xff,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 0xff,
  0xff, 0x00, 0x00, 0xff, 0x00, 0x00, 0x00, 0xff, 0x00, 0x00, 0x00, 0xff,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 0xff,
  0xff, 0x00, 0x00, 0xff, 0x00, 0x00, 0x00, 0xff, 0x00, 0x00, 0x00, 0xff,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 0xff,
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  0xff, 0x00, 0x00, 0xff, 0x00, 0x00, 0x00, 0xff, 0x00, 0x00, 0x00, 0xff,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 0xff,
};

const unsigned char SNOWFLAKE[NUM_COLS * NUM_LEDS * 4] = {
  0x00, 0x00, 0x00, 0xff, 0x00, 0x00, 0x00, 0xff, 0x00, 0x00, 0x00, 0xff,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 0xff, 
  0x00, 0x00, 0x00, 0xff, 0x00, 0x00, 0x00, 0xff, 0x00, 0x00, 0x00, 0xff,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 0xff, 
  0x00, 0x00, 0x00, 0xff, 0x00, 0x00, 0x00, 0xff, 0x00, 0x00, 0x00, 0xff,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 0xff, 
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  0x00, 0x00, 0x00, 0xff, 0x00, 0x00, 0x00, 0xff, 0x00, 0x00, 0x00, 0xff,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 0xff,
};

const unsigned char GLOBE[NUM_COLS * NUM_LEDS * 4] = {
  0x33, 0x0a, 0x0a, 0xff, 0x33, 0x0a, 0x0a, 0xff, 0x33, 0x0a, 0x0a, 0xff,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 0xff, 
  0x33, 0x0a, 0x0a, 0xff, 0x33, 0x0a, 0x0a, 0xff, 0x33, 0x0a, 0x0a, 0xff,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 0xff, 
  0x33, 0x0a, 0x0a, 0xff, 0x33, 0x0a, 0x0a, 0xff, 0x33, 0x0a, 0x0a, 0xff,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 0xff, 
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  0xa7, 0xa8, 0xa9, 0xff, 0xaa, 0xab, 0xac, 0xff, 0xa8, 0xa5, 0xa3, 0xff,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 0xff,  
};

const unsigned char GLOBE_BW[NUM_COLS * NUM_LEDS * 4] = {
  0x00, 0x00, 0x00, 0xff, 0x00, 0x00, 0x00, 0xff, 0x00, 0x00, 0x00, 0xff,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 0xff, 
  0x00, 0x00, 0x00, 0xff, 0x00, 0x00, 0x00, 0xff, 0x00, 0x00, 0x00, 0xff,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 0xff, 
  0x00, 0x00, 0x00, 0xff, 0x00, 0x00, 0x00, 0xff, 0x00, 0x00, 0x00, 0xff,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 0xff, 
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  0xff, 0xff, 0xff, 0xff, 0xff, 0xff, 0xff, 0xff, 0xff, 0xff, 0xff, 0xff,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 0xff,  
};

WiFiSSLClient client;
Adafruit_SSD1306 display(SCREEN_WIDTH, SCREEN_HEIGHT, &Wire, OLED_RESET);

int status = WL_IDLE_STATUS;     // the WiFi radio's status
int appStatus = APP_STARTUP;
String response;
String location;
int santaX;
int santaY;
bool sensorDetected = false;
bool rainbowRunning = false;
unsigned long rotDuration = 0;
unsigned long minDuration = 0x7FFFFFFF;
unsigned long maxDuration = 0;
unsigned long prevMicros = 0;
unsigned long startMillis = 0;
unsigned long updateMillis = 0;
unsigned long fetchMillis = 0;
unsigned long mapMillis = 0;
unsigned long snowFlakeMillis = 0;
unsigned long overflows = 0;
unsigned long detects = 0;

CRGB leds[(NUM_LEDS*2) + NUM_EXTRA];

void printWiFiStatus() {
  // print the SSID of the network you're attached to:
  Serial.print("SSID: ");
  Serial.println(WiFi.SSID());

  // print your board's IP address:
  IPAddress ip = WiFi.localIP();
  Serial.print("IP Address: ");
  Serial.println(ip);

  // print the received signal strength:
  long rssi = WiFi.RSSI();
  Serial.print("signal strength (RSSI):");
  Serial.print(rssi);
  Serial.println(" dBm");
}

void setupDisplay()
{
 // Clear the buffer
  display.begin();
  display.clearDisplay();

  // Show the display buffer on the screen. You MUST call display() after
  // drawing commands to make them visible on screen!
  display.display();
}

void setupWifi()
{
// check for the WiFi module:
  if (WiFi.status() == WL_NO_MODULE) {
    Serial.println("Communication with WiFi module failed!");
    // don't continue
    while (true);
  }

  String fv = WiFi.firmwareVersion();
  if (fv < WIFI_FIRMWARE_LATEST_VERSION) {
    Serial.println("Please upgrade the firmware");
  }

  // attempt to connect to WiFi network:
  while (status != WL_CONNECTED) {
    Serial.print("Attempting to connect to SSID: ");
    Serial.println(MYSSID);
    // Connect to WPA/WPA2 network. Change this line if using open or WEP network:
    status = WiFi.begin(MYSSID, PASSWORD);

    // wait 10 seconds for connection:
    delay(10000);
  }
  Serial.println("Connected to WiFi");
  printWiFiStatus();
}

void requestPosition()
{
  Serial.println("\nStarting connection to server...");
  // if you get a connection, report back via serial:
  if (client.connect(HOST, 443)) {
    Serial.println("connected to server");
    // Make a HTTP request:
    client.print("GET ");
    client.print(URL);
    client.println(" HTTP/1.1");
    client.print("Host: ");
    client.println(HOST);
    client.println("Connection: close");
    client.println();
  }
}

void calcSantaPos(String loc)
{
  int idx = loc.indexOf(",");
  if (idx == -1)
    return;

  String lat = loc.substring(0, idx);
  String lon = loc.substring(idx+1);

  int iLat = lat.toInt();
  int iLon = lon.toInt();

  santaX = (NUM_VIS_LEDS/2) - ((iLat * (NUM_VIS_LEDS/2)) / 90);
  santaY = (NUM_COLS/2) - ((iLon * (NUM_COLS/2)) / 180);
}

bool checkResponse()
{
  // from the server, read them and print them:
  while (client.available()) {
    char c = client.read();
    response += c;
    Serial.write(c);
  }

  // if the server's disconnected, stop the client:
  if (!client.connected()) {
    Serial.println();
    Serial.println("disconnecting from server.");
    client.stop();
  }

  int idx = response.indexOf("\r\n\r\n");
  if (idx > 0)
  {
    String jsonResponse = response.substring(idx+1);
    
    StaticJsonDocument<512> doc;
    deserializeJson(doc, jsonResponse);

    const char* loc = doc["location"];
    location = loc;
    calcSantaPos(location);
    Serial.println(loc);
    response = "";

    return true;
  }

  return false;
}

void updateDisplay()
{
  char text[20];
  display.fillRect(0, 0, SCREEN_WIDTH, SCREEN_HEIGHT, SSD1306_BLACK);

  display.setTextColor(SSD1306_WHITE);
  display.setTextSize(1);

  display.setCursor(0, 8);
  display.println(location);

  sprintf(text, "%8d",  overflows);
  display.setCursor(0, 16);
  display.println(text);

  sprintf(text, "%8d",  detects);
  display.setCursor(0, 24);
  display.println(text);

  sprintf(text, "%8lu",  minDuration);
  display.setCursor(64, 16);
  display.println(text);

  sprintf(text, "%8lu",  maxDuration);
  display.setCursor(64, 24);
  display.println(text);

  sprintf(text, "%d",  appStatus);
  display.setCursor(0, 0);
  display.println(text);

  display.display();
}

void rainbow()
{
  uint8_t thisSpeed = 100;
  uint8_t deltaHue= 10;
  uint8_t thisHue = beat8(thisSpeed,255); 
  fill_rainbow(leds, NUM_LEDS, thisHue, deltaHue);            
  FastLED.show();
}

void updateLEDs(const unsigned char* image, bool showPos)
{
  int i, r;
  unsigned long colDelay = rotDuration / NUM_COLS;

#if 1
  const unsigned char* ptr = image;
  int c = (NUM_COLS / 2);

  for (i=0; i<NUM_COLS; i++)
  {
    unsigned long startMicros = micros();
    const unsigned char* tmp = ptr;
    for (r=0; r<NUM_VIS_LEDS; r++)
    {
      if (showPos && (r == santaX) && (i == santaY))
        leds[(NUM_VIS_LEDS-1)-r] = CRGB(100, 0, 0);
      else  
        leds[(NUM_VIS_LEDS-1)-r] = CRGB(*(tmp+2), *(tmp+1), *(tmp+0));

      tmp += (NUM_COLS * 4);
    }

    /*
    tmp = ptr + (c * 4);
    for (r=0; r<NUM_LEDS; r++)
    {
      if ((r == santaX) && (c == santaY))
        leds[NUM_LEDS+NUM_EXTRA+r] = CRGB(100, 0, 0);
      else  
        leds[NUM_LEDS+NUM_EXTRA+r] = CRGB(*(tmp+2), *(tmp+1), *(tmp+0));
      
      tmp += (NUM_COLS * 4);
    }
    */
    
    FastLED.show();

    if (i < NUM_COLS-1)
    {
      unsigned long elapsedMicros = micros() - startMicros;
      if (elapsedMicros < colDelay)
        delayMicroseconds(colDelay - elapsedMicros);
      else
        overflows ++;
    }
        
    c ++;
    if (c >= (NUM_COLS/2))
      c = 0;
      
    ptr += 4;
  }
#endif

#if 0
  // TEST: vertical red line
  for (i=0; i<NUM_COLS; i++)
  {
    unsigned long startMicros = micros();
    for (r=0; r<NUM_LEDS; r++)
    {
      if (i % 10 == 0)
        leds[NUM_LEDS-1-r] = CRGB(255, 0, 0);
      else
        leds[NUM_LEDS-1-r] = CRGB(0, 255, 0);
    }

    FastLED.show();

    unsigned long elapsedMicros = micros() - startMicros;
    if (elapsedMicros < colDelay)
      delayMicroseconds(colDelay - elapsedMicros);
    else
      overflows ++;
  }
#endif
}

void sensorISR()
{
  sensorDetected = true;
  
  unsigned long currMicros = micros();
  if (prevMicros != 0)
  {
    rotDuration = currMicros - prevMicros;
    if (rotDuration < minDuration)
      minDuration = rotDuration;
    if (rotDuration > maxDuration)
      maxDuration = rotDuration;
  }

  detects ++;
  prevMicros = currMicros;
}

void setup() {
  // put your setup code here, to run once:
  Serial.begin(9600);
  Serial.println("Start");

  pinMode(SENSOR_PIN, INPUT_PULLUP);
  attachInterrupt(digitalPinToInterrupt(SENSOR_PIN), sensorISR, RISING);

  FastLED.addLeds<WS2812, LEDS_PIN, GRB>(leds, TOTAL_LEDS);
  rainbow();

  setupDisplay();
  updateDisplay();
  
  setupWifi();

  appStatus = APP_STARTUP;
  santaX = santaY = -1;
  startMillis = millis();
}

void loop() {
  if (appStatus == APP_MAP)
  {
    if (sensorDetected)
    {
      updateLEDs(GLOBE_BW, true);
      sensorDetected = false;
    }

    unsigned long delta = millis() - mapMillis;
    if (delta > MAP_TIME_MS)
    {
      appStatus = APP_SNOWFLAKE;
      updateDisplay();

      snowFlakeMillis = millis();
    }

    delta = millis() - fetchMillis;
    if (delta > FETCH_TIME_MS)
    {
      rainbow();
      requestPosition();

      appStatus = APP_FETCHING;
      updateDisplay();

      fetchMillis = millis();
      updateMillis = millis();
    }
  }
  if (appStatus == APP_SNOWFLAKE)
  {
    if (sensorDetected)
    {
      updateLEDs(SNOWFLAKE, false);
      sensorDetected = false;
    }

    unsigned long delta = millis() - snowFlakeMillis;
    if (delta > SNOWFLAKE_TIME_MS)
    {
      appStatus = APP_MAP;
      updateDisplay();

      mapMillis = millis();
    }
  }
  else if (appStatus == APP_FETCHING)
  {
    if (sensorDetected)
    {
      rainbow();
      sensorDetected = false;
    }

    unsigned long delta = millis() - updateMillis;
    if (delta > 3000)
    {
      if (checkResponse())
      {
        appStatus = APP_MAP;
        updateDisplay();

        mapMillis = millis();
      }
    }
  }
  else if (appStatus == APP_STARTUP)
  {
      rainbow();
      requestPosition();
      appStatus = APP_FETCHING;
      updateDisplay();

      fetchMillis = millis();
      updateMillis = millis();
  }
}
